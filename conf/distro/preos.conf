## conf/distro/preos.conf
```bitbake
# Distribution definition for: preos
#
# Copyright (c) Yin Kangkai
# All rights reserved.
#
# This file is released under the MIT license as described in
# ../meta/COPYING.MIT.
#
# Pre-OS is intended to be a tiny initrd that could working with a kernel and
# provide user a minimal user-space to base on and run their applications.

require conf/distro/poky.conf
DISTRO = "preos"

# By default we only support initramfs.
IMAGE_FSTYPES = "cpio.gz"

# We don't want GPLv3 packages
INCOMPATIBLE_LICENSE = "GPLv3"
```

## conf/layer.conf
```bitbake
BBPATH .= ":${LAYERDIR}"

BBFILES += "${LAYERDIR}/recipes-*/*/*.bb \
            ${LAYERDIR}/recipes-*/*/*.bbappend"

BBFILE_COLLECTIONS += "preos"
BBFILE_PATTERN_preos := "^${LAYERDIR}/"
BBFILE_PRIORITY_preos = "5"
```
